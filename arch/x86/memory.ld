MEMORY
    {
        RAM : ORIGIN = 0x00100000, LENGTH = 1M
    }

REGION_ALIAS("REGION_MULTIBOOT", RAM);
REGION_ALIAS("REGION_TEXT", RAM);
REGION_ALIAS("REGION_RODATA", RAM);
REGION_ALIAS("REGION_DATA", RAM);
REGION_ALIAS("REGION_BSS", RAM);
REGION_ALIAS("REGION_COMMON", RAM);

PROVIDE(START_ADDR = ORIGIN(RAM));
